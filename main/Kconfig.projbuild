## main/Kconfig.projbuild
```kconfig
menu "NSController Configuration"

    config MCU_DEBUG
        bool "Enable MCU debug logging"
        default n
        help
            Enable detailed debug output for MCU operations.
    
    config SAVE_PAIRING_INFO
        bool "Save pairing information"
        default y
        help
            Save pairing information to flash memory for future use.

    choice TRANSPORT_LAYER_CHOICE
        prompt "Transport Layer"
        default TRANSPORT_LAYER_UART
        help
            Select the physical transport layer for controller communication.

        config TRANSPORT_LAYER_UART
            bool "UART (GPIO4/5, default)"
            help
                Use UART1 (GPIO4=RX, GPIO5=TX) for communication.

        config TRANSPORT_LAYER_USB_SERIAL_JTAG
            bool "USB Serial/JTAG (USB port)"
            help
                Use USB Serial/JTAG controller for communication.
                Device will appear as /dev/ttyACM0 on Linux.
                Note: Ensure console is set to UART0 when using this option.

        config TRANSPORT_LAYER_USB_CDC
            bool "USB CDC (Virtual Serial, ESP32-S3)"
            depends on IDF_TARGET_ESP32S3
            help
                Use USB OTG CDC ACM for communication.
                Device will appear as a virtual serial port (/dev/ttyACM0 on Linux).
                Note: Ensure console is set to UART0 when using this option.
    endchoice

    config TRANSPORT_LAYER
        int
        default 0 if TRANSPORT_LAYER_UART
        default 1 if TRANSPORT_LAYER_USB_SERIAL_JTAG
        default 2 if TRANSPORT_LAYER_USB_CDC

    choice PROTOCOL_LAYER_CHOICE
        prompt "Protocol Layer"
        default PROTOCOL_LAYER_SIMPLE
        help
            Select the protocol layer implementation for the transport layer.

        config PROTOCOL_LAYER_SIMPLE
            bool "Simple protocol layer (default)"

        config PROTOCOL_LAYER_EASYCON
            bool "EasyCon protocol layer"
    endchoice

    config PROTOCOL_LAYER
        int
        default 0 if PROTOCOL_LAYER_SIMPLE
        default 1 if PROTOCOL_LAYER_EASYCON

    config UART_RX_PIN
        int "UART RX Pin (GPIO)"
        default 4
        help
            GPIO number for UART RX pin. Default is GPIO4.

    config UART_TX_PIN
        int "UART TX Pin (GPIO)"
        default 5
        help
            GPIO number for UART TX pin. Default is GPIO5.

    config HID_REPORT_INTERVAL
        int "HID Report Interval (ms)"
        default 15
        range 5 100
        help
            Interval between HID report transmissions in milliseconds.
            Lower values provide lower latency but require more CPU processing.
            For ESP32-C61 (single-core), 20ms is recommended to avoid mbuf allocation failures.

endmenu
```

## sdkconfig.defaults.esp32c61
```kconfig
# Test on ESP32-C61-DevKitC-1-N8R2

CONFIG_IDF_TARGET="esp32c61"
CONFIG_BT_ENABLED=y
CONFIG_BT_NIMBLE_ENABLED=y

# 70 -> 257(max)
CONFIG_BT_NIMBLE_HCI_EVT_BUF_SIZE=257
CONFIG_BT_NIMBLE_EXT_ADV=y

# use jtag for transport layer
CONFIG_TRANSPORT_LAYER_USB_SERIAL_JTAG=y
CONFIG_ESP_CONSOLE_SECONDARY_NONE=y

# C61 single-core: use 20ms interval to avoid mbuf allocation failures
CONFIG_HID_REPORT_INTERVAL=20

# FLASH
CONFIG_ESPTOOLPY_FLASHSIZE_8MB=y
CONFIG_PARTITION_TABLE_CUSTOM=y
CONFIG_PARTITION_TABLE_CUSTOM_FILENAME="partitions_n2c.csv"

# Memory
CONFIG_BT_NIMBLE_MSYS_1_BLOCK_COUNT=150
CONFIG_BT_NIMBLE_MSYS_1_BLOCK_SIZE=128
CONFIG_BT_NIMBLE_MSYS_2_BLOCK_COUNT=30
CONFIG_BT_NIMBLE_MSYS_2_BLOCK_SIZE=512
```

## sdkconfig.defaults.esp32s3
```kconfig
# Test on ESP32-C61-DevKitC-1-N8R2

CONFIG_IDF_TARGET="esp32s3"
CONFIG_BT_ENABLED=y
CONFIG_BT_NIMBLE_ENABLED=y

# !! ESP-IDF support connection intervals down to 2.5 ms. (non-BLE-spec compliant)
CONFIG_BT_CTRL_BLE_MIN_CONN_INTERVAL_ENABLE=y

# use usb cdc for transport layer
CONFIG_TRANSPORT_LAYER_USB_CDC=y
CONFIG_TINYUSB_CDC_ENABLED=y
CONFIG_ESP_CONSOLE_SECONDARY_NONE=y

# S3
CONFIG_HID_REPORT_INTERVAL=15

# FLASH
CONFIG_ESPTOOLPY_FLASHSIZE_8MB=y
CONFIG_PARTITION_TABLE_CUSTOM=y
CONFIG_PARTITION_TABLE_CUSTOM_FILENAME="partitions_n2c.csv"

# S3
CONFIG_BTDM_CTRL_MODE_BLE_ONLY=y
CONFIG_BTDM_CTRL_MODE_BR_EDR_ONLY=n
CONFIG_BTDM_CTRL_MODE_BTDM=n
CONFIG_BT_BLUEDROID_ENABLED=n
```
